## buildroot/Config.in
```kconfig
source "$BR2_EXTERNAL_beaglebone_flasher_PATH/package/beaglebone_flasher/Config.in"
```

## buildroot/package/beaglebone_flasher/Config.in
```kconfig
config BR2_PACKAGE_BEAGLEBONE_FLASHER
	bool "beaglebone_flasher"
	depends on BR2_PACKAGE_XZ
	depends on BR2_SYSTEM_BIN_SH_BASH
	help
		Write /run/flasher.img.xz to eMMC on BeagleBone at boot
```
